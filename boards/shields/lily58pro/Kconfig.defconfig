## boards/shields/lily58pro/Kconfig.defconfig
```kconfig
if SHIELD_LILY58PRO_D

# Name must be less than 16 characters long!
config ZMK_KEYBOARD_NAME
    default "LILY58-PROADEPT"

config ZMK_SPLIT_ROLE_CENTRAL
    default y

config ZMK_SPLIT
    default y

# Set this to the number of peripherals your dongle will have.
# For a unibody, this would be 1. If you have left and right halves, set it to 2, etc.
config ZMK_SPLIT_BLE_CENTRAL_PERIPHERALS
    default 3

config ZMK_POINTING
    default y

config ZMK_BLE
    default y

config ZMK_USB 
    default y

# Set this to ZMK_SPLIT_BLE_CENTRAL_PERIPHERALS + your desired number of BT profiles (default is 5)
# config BT_MAX_CONN
    # default 5

# Set this to the same number as BT_MAX_CONN
# config BT_MAX_PAIRED
    # default 5

endif

if SHIELD_TRANADEPTBLE

# This is for TranAdept BLE
config SPI
    default y

config ZMK_BLE
    default y

config ZMK_POINTING
    default y

config ZMK_SPLIT
    default y

endif

if SHIELD_LILY58PRO_L || SHIELD_LILY58PRO_R

config ZMK_SPLIT
    default y

config ZMK_BLE
    default y

endif
```

## boards/shields/lily58pro/Kconfig.shield
```kconfig
# No whitespace after the comma or in the keyboard name!
config SHIELD_LILY58PRO_D
    def_bool $(shields_list_contains,lily58pro_d)

config SHIELD_LILY58PRO_L
    def_bool $(shields_list_contains,lily58pro_l)

config SHIELD_LILY58PRO_R
    def_bool $(shields_list_contains,lily58pro_r)

config SHIELD_TRANADEPTBLE
    def_bool $(shields_list_contains,TranAdeptBLE)
```
